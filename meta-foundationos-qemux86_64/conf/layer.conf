## meta-foundationos-qemux86_64/conf/layer.conf
```bitbake
# We have a conf and classes directory, add to BBPATH
BBPATH .= ":${LAYERDIR}"

# We have a recipes-* directories, add to BBFILES
BBFILES += "${LAYERDIR}/recipes-*/*/*.bb \
	${LAYERDIR}/recipes-*/*/*.bbappend"

BBFILE_COLLECTIONS += "foundationos-qemu"
BBFILE_PATTERN_foundationos-qemu = "^${LAYERDIR}/"
BBFILE_PRIORITY_foundationos-qemu = "6"
```

## meta-foundationos-qemux86_64/conf/machine/foundationos-qemux86-64.conf
```bitbake
#@TYPE: Machine
#@NAME: foundationos-qemux86-64.conf

#@DESCRIPTION: Machine configuration for foundationos-qemux86 systems

PREFERRED_VERSION_linux-yocto ?= "4.19%"

PREFERRED_PROVIDER_virtual/bootloader ??= "u-boot"
PREFERRED_VERSION_u-boot = "2019.01"
PREFERRED_PROVIDER_virtual/dtb = "device-tree"

UBOOR_ARCH="x86_64"
UBOOT_SUFFIX="rom"
UBOOT_MACHINE="foundationos_qemux86_mmc_config"
UBOOT_ENTRYPOINT="0x00000000"
UBOOT_LOADADDRESS="0x01000000"

#FIT Image parameters.
IMAGE_BOOT_FILES_append = "fitImage"

IMAGE_INSTALL_append = " kernel-image"

require conf/machine/include/qemu.inc
DEFAULTTUNE ?= "core2-64"
require conf/machine/include/tune-core2.inc
require conf/machine/include/qemuboot-x86.inc

MACHINE_FEATURES += "x86 pci"

MACHINE_ESSENTIAL_EXTRA_RDEPENDS += "v86d"

KERNEL_MODULE_AUTOLOAD += "uvesafb"
KERNEL_MODULE_PROBECONF += "uvesafb"
module_conf_uvesafb = "options uvesafb mode_option=${UVESA_MODE}"

KERNEL_IMAGETYPE = "fitImage"
KERNEL_CLASSES += "kernel-x86-fitimage"

SERIAL_CONSOLE = "115200 ttyS0"

FOUNDATIONOS_PTABLE_TYPE="gpt"

#Match alignment to sector size defined in wic
FOUNDATIONOS_PARTITION_ALIGNMENT_KB="512"

#Bootloader partition starts at 2
FOUNDATIONOS_PART_NUMBER_START = "2"

#Uboot Env reserved partition.
FOUNDATIONOS_QEMUX86_64_RESERVED_PART_SIZE="128k"

WKS_FILE = "foundationos-qemu.wks.in"
### wic default support
WKS_FILE_DEPENDS ?= " \
    virtual/bootloader \
    e2fsprogs-native \
    bmap-tools-native \
"
WICVARS_append = " \
    FOUNDATIONOS_QEMUX86_64_RESERVED_PART_SIZE \
"
```
